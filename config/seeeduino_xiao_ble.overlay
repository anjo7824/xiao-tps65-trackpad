#include <dt-bindings/zmk/input_transform.h>
#include <input/processors.dtsi>
#include <behaviors/input_gestures_accel.dtsi>

/ {
    chosen {
        zmk,pointing = &trackpad;
        zmk,kscan = &kscan0;
        #zephyr,console = &cdc_acm_uart0;
    };

    kscan0: kscan_0 {
        compatible = "zmk,kscan-gpio-direct";
        input-gpios = <&gpio0 9 (GPIO_ACTIVE_LOW | GPIO_PULL_UP)>;
    };

#    trackpad_listener {
#        compatible = "zmk,input-listener";
#        device = <&trackpad>;
#        input-processors = <&pointer_accel>;
#    };
};

&zephyr_udc0 {
    cdc_acm_uart0: cdc_acm_uart0 {
        compatible = "zephyr,cdc-acm-uart";
        label = "CDC_ACM_0";
    };
};

/* Konfiguration för acceleration enligt modulens specifikation */
&pointer_accel {
    input-type = <INPUT_EV_REL>;
    track-remainders;
    min-factor = <800>;
    max-factor = <4500>;
    speed-threshold = <1000>;
    speed-max = <4000>;
    acceleration-exponent = <3>;
};

&pinctrl {
    i2c0_default: i2c0_default {
        group1 {
            psels = <NRF_PSEL(TWIM_SDA, 0, 4)>,
                    <NRF_PSEL(TWIM_SCL, 0, 5)>;
        };
    };

    i2c0_sleep: i2c0_sleep {
        group1 {
            psels = <NRF_PSEL(TWIM_SDA, 0, 4)>,
                    <NRF_PSEL(TWIM_SCL, 0, 5)>;
        };
    };
};

&i2c0 {
    status = "okay";
    compatible = "nordic,nrf-twim";
    pinctrl-0 = <&i2c0_default>;
    pinctrl-1 = <&i2c0_sleep>;
    pinctrl-names = "default", "sleep";
    
    trackpad: iqs5xx@74 {
        compatible = "azoteq,iqs5xx";
        reg = <0x74>;
        rdy-gpios = <&gpio0 2 (GPIO_ACTIVE_LOW | GPIO_PULL_UP)>;
        
        /* Drivrutinens standardegenskaper */
        scroll;
        natural-scroll-y;
        tap-and-hold;
        tap-and-hold-release-timeout-ms = <500>;
        two-finger-tap;
        bottom-beta = <5>;
        switch-xy;
    };
};
